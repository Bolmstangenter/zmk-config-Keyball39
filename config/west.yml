## config/west.yml
```yaml
manifest:
  remotes:
    - name: zmkfirmware
      url-base: https://github.com/zmkfirmware
    - name: kumamuk-git
      url-base: https://github.com/kumamuk-git
    - name: infely                             
      url-base: https://github.com/infely
  projects:
    - name: zmk
      remote: zmkfirmware
      revision: v0.2
      import: app/west.yml
    - name: nice-view-battery                  
      remote: infely                           
      revision: main
    - name: zmk-pmw3610-driver
      remote: kumamuk-git
      revision: main
  self:
    path: config
```
